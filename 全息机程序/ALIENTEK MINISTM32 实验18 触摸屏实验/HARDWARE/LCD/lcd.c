#include "lcd.h"
#include "stdlib.h"
#include "font.h" 
#include "usart.h"
#include "delay.h"	 
//320240图形点阵液晶模块参考程序
//控制IC:RA8835
//点阵数:320*240

#define uchar		unsigned char
#define uint		unsigned int
#define text_home_address	0x0000	//文本显示区首地址
#define graphic_home_address	0x04b0	//图形显示区首地址
//#define data_bus		P1



uchar systemset_tab[]={0x30,0x87,0x0f,0x27,0x3a,0xef,0x28,0x00};
uchar scroll_tab[]={0x00,0x00,0xf0,0xb0,0x04,0xf0,0x30,0x2a,0xb0,0x4f};

unsigned char tab1[]={
/*--  调入了一幅图像：D:\我的文档\图片收藏\320240-1.bmp  --*/
/*--  宽度x高度=320x240  --*/
0xFF,0xFF,0xFF,0xFF,0xFF,0xFF,0xFF,0xFF,0xFF,0xFF,0xFF,0xFF,0xFF,0xFF,0xFF,0xFF,
0xFF,0xFF,0xFF,0xFF,0xFF,0xFF,0xFF,0xFF,0xFF,0xFF,0xFF,0xFF,0xFF,0xFF,0xFF,0xFF,
0xFF,0xFF,0xFF,0xFF,0xFF,0xFF,0xFF,0xFF,0x80,0x00,0x00,0x00,0x00,0x00,0x00,0x00,
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0xFF,0xFF,0xFF,0xFF,0xFF,0xFF,0xFF,0xFF,0xFF,0xFF,0xFF,0xFF,0xFF,0xFF,0xFF,0xFF,};

uchar tab2[]={
"                                        "
"                                        "
"                                        "
"                                        "
"                                        "
"                                        "
"                                        "
"                                        "};

//..........延时n毫秒..........
void delay_n_ms(uint ms)
{
	uint i,j;
	for(i=0;i<ms;i++)
		for(j=0;j<123;j++);
}
//..........测忙..........
void chk_lcm_busy(void)
{
	uchar lcm_data;
	lcm_cs=0;
	lcm_a0=0;
	lcm_wr=1;
	/*input*/
	GPIOD->CRL = 0x88888888;
	lcm_rd=0;
	delay_n_ms(1);
	while((GPIOD->IDR)&0x40);
	lcm_rd=1;
	lcm_cs=0;
	/*output*/
	GPIOD->CRL = 0x33333333;
}
//..........写命令到LCM..........
void send_cmd_to_lcm(uchar lcm_cmd)
{
	chk_lcm_busy();
	lcm_cs=0;
	lcm_a0=1;
	lcm_rd=1;
	lcm_WriteByte=lcm_cmd;
	lcm_wr=0;
	delay_n_ms(1);
	lcm_wr=1;
	delay_n_ms(1);
	lcm_cs=1;
}
//..........写数据到LCM..........
void send_data_to_lcm(uchar lcm_data)
{
	chk_lcm_busy();
	lcm_cs=0;
	lcm_a0=0;
	lcm_rd=1;
	lcm_WriteByte=lcm_data;
	lcm_wr=0;
	delay_n_ms(1);
	lcm_wr=1;
	delay_n_ms(1);
	lcm_cs=1;
}
//..........写1个命令和1个数据到LCM..........
void send_cmd_and_data_to_lcm(uchar lcm_cmd,uchar lcm_data)
{
	send_cmd_to_lcm(lcm_cmd);
	send_data_to_lcm(lcm_data);
}
//..........写1个16进制数据到LCM..........
void send_two_data_to_lcm(uint lcm_data)
{
	send_data_to_lcm(lcm_data);
	send_data_to_lcm(lcm_data>>8);
}
//..........从LCM读数据..........
uchar read_data_from_lcm(void)
{
	uchar lcm_data;
	chk_lcm_busy();
	lcm_cs=0;
	lcm_a0=0;
	lcm_wr=1;
	/*input*/
	GPIOD->CRL = 0x88888888;
	lcm_rd=0;
	delay_n_ms(1);
	lcm_data=GPIOD->IDR;
	lcm_rd=1;
	delay_n_ms(1);
	lcm_cs=0;
	/*output*/
	GPIOD->CRL = 0x33333333;
	return lcm_data;
}
char datalcd[150];
//..........初始化..........
void lcm_init(void)
{
	uchar i;
	GPIO_InitTypeDef GPIO_InitStructure;
	/*开启相应时钟 */
 	RCC_APB2PeriphClockCmd(RCC_APB2Periph_GPIOC|RCC_APB2Periph_GPIOD, ENABLE); 
	//GPIO_PinRemapConfig(GPIO_Remap_SWJ_JTAGDisable , ENABLE);
	
	/*控制信号*/
	GPIO_InitStructure.GPIO_Pin = GPIO_Pin_10|GPIO_Pin_9|GPIO_Pin_8|GPIO_Pin_7|GPIO_Pin_6;	   //GPIO_Pin_10
	GPIO_InitStructure.GPIO_Mode = GPIO_Mode_Out_PP;  //推挽输出
	GPIO_InitStructure.GPIO_Speed = GPIO_Speed_50MHz;
	GPIO_Init(GPIOC, &GPIO_InitStructure); //GPIOC
	GPIO_SetBits(GPIOC,GPIO_Pin_10|GPIO_Pin_9|GPIO_Pin_8|GPIO_Pin_7|GPIO_Pin_6);


	GPIO_InitStructure.GPIO_Pin = GPIO_Pin_All;
	GPIO_InitStructure.GPIO_Mode = GPIO_Mode_Out_PP;  //推挽输出
	GPIO_InitStructure.GPIO_Speed = GPIO_Speed_50MHz;
	GPIO_Init(GPIOD, &GPIO_InitStructure); //GPIOB
	GPIO_SetBits(GPIOD,GPIO_Pin_All);
	
	lcm_rst=0;
	delay_n_ms(5);
	lcm_rst=1;
	delay_n_ms(50);
	lcm_cs=0;
	send_cmd_to_lcm(0x40);				//WRITE SYSTEMSET 指令和参数
	for(i=0;i<8;i++)
		send_data_to_lcm(systemset_tab[i]);
		
	send_cmd_to_lcm(0x40);				//WRITE SYSTEMSET 指令和参数
	for(i=0;i<8;i++)
		datalcd[i]=read_data_from_lcm();
		
	send_cmd_to_lcm(0x44);				//WRITE SCROLL 指令和参数
	for(i=0;i<10;i++)
		send_data_to_lcm(scroll_tab[i]);
	send_cmd_and_data_to_lcm(0x5a,0x00);		//显示画面水平移动量
	send_cmd_and_data_to_lcm(0x5b,0x00);		//显示属性
	send_cmd_to_lcm(0x5d);				//光标设置
	send_two_data_to_lcm(0x8f07);
	send_cmd_to_lcm(0x4c);				//光标自动移动方向--向右
	send_cmd_and_data_to_lcm(0x59,0x54);		//DISP ON
}
//..........清显示RAM..........
void clr_ram(void)
{
	uchar i,j;
	send_cmd_to_lcm(0x46);
	send_two_data_to_lcm(0x0000);
	send_cmd_to_lcm(0x42);
	for(i=0;i<135;i++)
		for(j=0;j<80;j++)
			send_data_to_lcm(0x00);
}


//..........全屏显示点阵..........
void disp_lattice(uchar lcm_data1,uchar lcm_data2)
{
	uchar i,j;
	send_cmd_to_lcm(0x46);
	send_two_data_to_lcm(graphic_home_address);
	send_cmd_to_lcm(0x42);
	for(i=0;i<60;i++)
	{
		for(j=0;j<80;j++)
			send_data_to_lcm(lcm_data1);
		for(j=0;j<80;j++)
			send_data_to_lcm(lcm_data2);
	}
}
//..........显示图形..........
void disp_graphics(uchar *gph)
{
	uchar i,j;
//	send_cmd_to_lcm(0x4f);		//光标自动移动方向--向下
	send_cmd_to_lcm(0x46);
	send_two_data_to_lcm(graphic_home_address);
	send_cmd_to_lcm(0x42);
	for(i=0;i<240;i++)
	{
		for(j=0;j<40;j++)
		{
			send_data_to_lcm(*gph);
			gph++;
		}
	}
}
